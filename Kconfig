## Kconfig
```kconfig
#
# Goodix GT9xx Touchscreen driver
#
config TOUCHSCREEN_GT9XX
	bool "Goodix touchpanel GT9xx series"
	depends on I2C
	help
	  Say Y here if you have a Goodix GT9xx touchscreen
	  controller.

          If unsure, say N.

config TOUCHSCREEN_GT9XX_UPDATE
	tristate "Goodix GT9xx touch controller auto update support"
	depends on TOUCHSCREEN_GT9XX
	default y
	help
	  Enable this for support firmware update.

	  Say Y here if you want update touch controller firmware.

	  If unsure, say N.

config TOUCHSCREEN_GT9XX_TOOL
	tristate "Goodix GT9xx Tools for debuging"
	depends on TOUCHSCREEN_GT9XX
	default y
	help
	  This implement interface support for Goodix GT9xx
	  touchscreen debug.

	  Say Y here if you want to have a Android app debug interface
	  to your system.

	  If unsure, say N.
config TOUCHSCREEN_GT9XX_ROTATE_90
	bool "Goodix GT9xx ts rotate 90"
	default n
	help
	Say Y here if you have the touch panel rotate 90.

	If unsure, say N.

	To compile this dirver as a module, choose M here: the
	module will be called.

config TOUCHSCREEN_GT9XX_ROTATE_180
	bool "Goodix GT9xx ts rotate 180"
	default n
	help
	Say Y here if you have the touch panel rotate 180.

	If unsure, say N.

	To compile this dirver as a module, choose M here: the
	module will be called.

config TOUCHSCREEN_GT9XX_ROTATE_270
	bool "Goodix GT9xx ts rotate 270"
	default n
	help
	Say Y here if you have the touch panel rotate 270.

	If unsure, say N.

	To compile this dirver as a module, choose M here: the
	module will be called.
	
config TOUCHSCREEN_GT9XX_ROTATE_X_180
	bool "Goodix GT9xx ts rotate x axis 180"
	default n
	help
	Say Y here if you have the touch panel rotate x axis 180.

	If unsure, say N.

	To compile this dirver as a module, choose M here: the
	module will be called.
	
config TOUCHSCREEN_GT9XX_ROTATE_Y_180
	bool "Goodix GT9xx ts rotate y axis 180"
	default n
	help
	Say Y here if you have the touch panel rotate y axis 180.

	If unsure, say N.

	To compile this dirver as a module, choose M here: the
	module will be called.
```
